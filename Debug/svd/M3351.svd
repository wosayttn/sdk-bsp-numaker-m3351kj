# M3351 register map
File version: 1.0
M3351 SVD file
Registers are 32-bit, read-write, reset 0x0 unless marked. A register's access mark holds for its fields unless they carry their own. Offsets are from the block's base; lines under a group give offsets from that group; [hi:lo] are bit positions; {n}, {i} and the like mark numbered series; 'fields as' and 'values as' point back to an identical list; <NAME> marks a mode.

## Memory map
0x40000000 SYS blocks up to offset 0x604 — SYS Register Map
0x40000200 CLK blocks up to offset 0xC8 — CLK Register Map
0x40000300 NMI size 0xC — NMI Register Map
0x40004000 GPIO blocks up to offset 0x9F0 — GPIO Register Map
0x40008000 PDMA0 blocks up to offset 0x48C — PDMA Register Map
0x40009000 USBH0 blocks up to offset 0x208 — USBH Register Map
0x4000C000 FMC blocks up to offset 0x140 — FMC Register Map
0x4000F000 DFMC blocks up to offset 0x144 — DFMC Register Map
0x40010000 EBI blocks up to offset 0x28 — EBI Register Map
0x40020000 CANFD0 blocks up to offset 0x100 — CANFD Register Map
0x40024000 CANFD1 blocks up to offset 0x100 — CANFD Register Map
0x4002F000 SCU blocks up to offset 0x210 — SCU Register Map
0x40032000 CRYPTO blocks up to offset 0x500 — CRYPTO Register Map
0x40036000 CACHE size 0x14 — CACHE Register Map
0x40040000 WDT0 size 0x10 — WDT Register Map
0x40041000 RTC blocks up to offset 0x114 — RTC Register Map
0x40042000 WDT1 size 0x10 — WDT Register Map
0x40043000 EADC0 blocks up to offset 0xFFC — EADC Register Map
0x40045000 ACMP01 size 0x18 — ACMP Register Map
0x40047000 DAC size 0x18 — DAC Register Map
0x4004B000 EADC1 blocks up to offset 0xFFC — EADC Register Map
0x40050000 TMR01 blocks up to offset 0x1B8 — TIMER Register Map
0x40051000 TMR23 blocks up to offset 0x1B8 — TIMER Register Map
0x4005A000 BPWM0 blocks up to offset 0x334 — BPWM Register Map
0x4005B000 BPWM1 blocks up to offset 0x334 — BPWM Register Map
0x4005C000 PWM0 blocks up to offset 0x334 — PWM Register Map
0x4005D000 PWM1 blocks up to offset 0x334 — PWM Register Map
0x40060000 QSPI0 blocks up to offset 0x34 — QSPI Register Map
0x40061000 SPI0 blocks up to offset 0x6C — SPI Register Map
0x40062000 SPI1 blocks up to offset 0x6C — SPI Register Map
{0x40070000+0x1000*n} UART{n} size 0x58 (n=0..9) — UART Register Map
0x40080000 I2C0 blocks up to offset 0x6C — I2C Register Map
0x40081000 I2C1 blocks up to offset 0x6C — I2C Register Map
0x40082000 I2C2 blocks up to offset 0x6C — I2C Register Map
0x40086000 I3C0 blocks up to offset 0x570 — I3C Register Map
0x40088000 LLSI0 size 0x24 — LLSI Register Map
0x40088200 LLSI2 size 0x24 — LLSI Register Map
0x40088400 LLSI4 size 0x24 — LLSI Register Map
0x40088600 LLSI6 size 0x24 — LLSI Register Map
0x40088800 LLSI8 size 0x24 — LLSI Register Map
0x40089000 LLSI1 size 0x24 — LLSI Register Map
0x40089200 LLSI3 size 0x24 — LLSI Register Map
0x40089400 LLSI5 size 0x24 — LLSI Register Map
0x40089600 LLSI7 size 0x24 — LLSI Register Map
0x40089800 LLSI9 size 0x24 — LLSI Register Map
0x4008A000 ELLSI0 size 0xC4 — ELLSI Register Map
0x4008B000 ELLSI1 size 0xC4 — ELLSI Register Map
0x40096000 WWDT0 size 0x10 — WWDT Register Map
0x40098000 WWDT1 size 0x10 — WWDT Register Map
0x400B0000 EQEI0 blocks up to offset 0x30 — EQEI Register Map
0x400B1000 EQEI1 blocks up to offset 0x30 — EQEI Register Map
0x400B4000 ECAP0 size 0x20 — ECAP Register Map
0x400B9000 TRNG size 0x1C — TRNG Register Map
0x400C0000 USBD blocks up to offset 0x670 — USBD Register Map
0x400D0000 UUART0 blocks up to offset 0x68 — USCIUART Register Map
0x400D0000 USPI0 blocks up to offset 0x68 — USCISPI Register Map
0x400D0000 UI2C0 blocks up to offset 0x90 — USCII2C Register Map
0x400D1000 UUART1 blocks up to offset 0x68 — USCIUART Register Map
0x400D1000 USPI1 blocks up to offset 0x68 — USCISPI Register Map
0x400D1000 UI2C1 blocks up to offset 0x90 — USCII2C Register Map
0x4020B000 CRC blocks up to offset 0x50 — CRC Register Map
0x50000000 SYS_NS blocks up to offset 0x104 — SYS Register Map
0x50004000 GPIO_NS blocks up to offset 0x9F0 — GPIONS Register Map
0x50008000 PDMA0_NS blocks up to offset 0x48C — PDMANS Register Map
0x50009000 USBH0_NS blocks up to offset 0x208 — USBHNS Register Map
0x5000C000 FMC_NSBA blocks up to offset 0x140 — FMC Register Map
0x5000F000 DFMC_NSBA blocks up to offset 0x144 — DFMC Register Map
0x50010000 EBI_NS blocks up to offset 0x28 — EBINS Register Map
0x50020000 CANFD0_NS blocks up to offset 0x100 — CANFDNS Register Map
0x50024000 CANFD1_NS blocks up to offset 0x100 — CANFDNS Register Map
0x5002F000 SCU_NS blocks up to offset 0x210 — SCU Register Map
0x50036000 CACHE_NS size 0x14 — CACHENS Register Map
0x50041000 RTC_NS blocks up to offset 0x114 — RTCNS Register Map
0x50042000 WDT1_NS size 0x10 — WDTNS Register Map
0x50043000 EADC0_NS blocks up to offset 0xFFC — EADC Register Map
0x50045000 ACMP01_NS size 0x18 — ACMP Register Map
0x50047000 DAC_NS size 0x18 — DAC Register Map
0x5004B000 EADC1_NS blocks up to offset 0xFFC — EADC Register Map
0x50050000 TMR01_NS blocks up to offset 0x1B8 — TIMERNS Register Map
0x50051000 TMR23_NS blocks up to offset 0x1B8 — TIMERNS Register Map
0x5005A000 BPWM0_NS blocks up to offset 0x334 — BPWMNS Register Map
0x5005B000 BPWM1_NS blocks up to offset 0x334 — BPWMNS Register Map
0x5005C000 PWM0_NS blocks up to offset 0x334 — PWMNS Register Map
0x5005D000 PWM1_NS blocks up to offset 0x334 — PWMNS Register Map
0x50060000 QSPI0_NS blocks up to offset 0x34 — QSPINS Register Map
0x50061000 SPI0_NS blocks up to offset 0x6C — SPINS Register Map
0x50062000 SPI1_NS blocks up to offset 0x6C — SPINS Register Map
{0x50070000+0x1000*n} UART{n}_NS size 0x58 (n=0..9) — UARTNS Register Map
0x50080000 I2C0_NS blocks up to offset 0x6C — I2CNS Register Map
0x50081000 I2C1_NS blocks up to offset 0x6C — I2CNS Register Map
0x50082000 I2C2_NS blocks up to offset 0x6C — I2CNS Register Map
0x50086000 I3C0_NS blocks up to offset 0x570 — I3CNS Register Map
0x50088000 LLSI0_NS size 0x24 — LLSINS Register Map
0x50088200 LLSI2_NS size 0x24 — LLSINS Register Map
0x50088400 LLSI4_NS size 0x24 — LLSINS Register Map
0x50088600 LLSI6_NS size 0x24 — LLSINS Register Map
0x50088800 LLSI8_NS size 0x24 — LLSINS Register Map
0x50089000 LLSI1_NS size 0x24 — LLSINS Register Map
0x50089200 LLSI3_NS size 0x24 — LLSINS Register Map
0x50089400 LLSI5_NS size 0x24 — LLSINS Register Map
0x50089600 LLSI7_NS size 0x24 — LLSINS Register Map
0x50089800 LLSI9_NS size 0x24 — LLSINS Register Map
0x5008A000 ELLSI0_NS size 0xC4 — ELLSINS Register Map
0x5008B000 ELLSI1_NS size 0xC4 — ELLSINS Register Map
0x50098000 WWDT1_NS size 0x10 — WWDTNS Register Map
0x500B0000 EQEI0_NS blocks up to offset 0x30 — EQEINS Register Map
0x500B1000 EQEI1_NS blocks up to offset 0x30 — EQEINS Register Map
0x500B4000 ECAP0_NS size 0x20 — ECAPNS Register Map
0x500B9000 TRNG_NS size 0x1C — TRNG Register Map
0x500C0000 USBD_NS blocks up to offset 0x670 — USBDNS Register Map
0x500D0000 UUART0_NS blocks up to offset 0x68 — USCIUARTNS Register Map
0x500D0000 USPI0_NS blocks up to offset 0x68 — USCISPINS Register Map
0x500D0000 UI2C0_NS blocks up to offset 0x90 — USCII2CNS Register Map
0x500D1000 UUART1_NS blocks up to offset 0x68 — USCIUARTNS Register Map
0x500D1000 USPI1_NS blocks up to offset 0x68 — USCISPINS Register Map
0x500D1000 UI2C1_NS blocks up to offset 0x90 — USCII2CNS Register Map
0x5020B000 CRC_NS blocks up to offset 0x50 — CRCNS Register Map
0xE000E000 SCS blocks up to offset 0xD24 — SYST_SCR Register Map
0xE000E100 NVIC blocks up to offset 0xE04 — NVIC Register Map
